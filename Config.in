## Config.in
```kconfig
source "$BR2_EXTERNAL_edgemap_PATH/package/libnitrokey/Config.in"
source "$BR2_EXTERNAL_edgemap_PATH/package/nkmacsec/Config.in"
source "$BR2_EXTERNAL_edgemap_PATH/package/python-argparse/Config.in"
source "$BR2_EXTERNAL_edgemap_PATH/package/python-dateutils/Config.in"
source "$BR2_EXTERNAL_edgemap_PATH/package/python-taky/Config.in"
source "$BR2_EXTERNAL_edgemap_PATH/package/gwsocket/Config.in"
source "$BR2_EXTERNAL_edgemap_PATH/package/highrate/Config.in"
source "$BR2_EXTERNAL_edgemap_PATH/package/curlcot/Config.in"
source "$BR2_EXTERNAL_edgemap_PATH/package/cotsim/Config.in"
source "$BR2_EXTERNAL_edgemap_PATH/package/tacmsgrouter/Config.in"
source "$BR2_EXTERNAL_edgemap_PATH/package/rpiboot/Config.in"
source "$BR2_EXTERNAL_edgemap_PATH/package/audioreceiver/Config.in"
source "$BR2_EXTERNAL_edgemap_PATH/package/audiostreamer/Config.in"
source "$BR2_EXTERNAL_edgemap_PATH/package/modmodem/Config.in"
source "$BR2_EXTERNAL_edgemap_PATH/package/udp2raw/Config.in"
source "$BR2_EXTERNAL_edgemap_PATH/package/rtptun/Config.in"
source "$BR2_EXTERNAL_edgemap_PATH/package/udpspeeder/Config.in"
source "$BR2_EXTERNAL_edgemap_PATH/package/udptunnel/Config.in"
source "$BR2_EXTERNAL_edgemap_PATH/package/coturn/Config.in"
source "$BR2_EXTERNAL_edgemap_PATH/package/gsocket/Config.in"
source "$BR2_EXTERNAL_edgemap_PATH/package/libblinkstick/Config.in"
source "$BR2_EXTERNAL_edgemap_PATH/package/libfido2/Config.in"
source "$BR2_EXTERNAL_edgemap_PATH/package/libcbor/Config.in"
source "$BR2_EXTERNAL_edgemap_PATH/package/python-meshtastic/Config.in"
source "$BR2_EXTERNAL_edgemap_PATH/package/python-pubsub/Config.in"
source "$BR2_EXTERNAL_edgemap_PATH/package/python-dotmap/Config.in"
source "$BR2_EXTERNAL_edgemap_PATH/package/python-tabulate/Config.in"
source "$BR2_EXTERNAL_edgemap_PATH/package/python-timeago/Config.in"
source "$BR2_EXTERNAL_edgemap_PATH/package/python-twine/Config.in"
source "$BR2_EXTERNAL_edgemap_PATH/package/python-autopep8/Config.in"
source "$BR2_EXTERNAL_edgemap_PATH/package/python-pylint/Config.in"
source "$BR2_EXTERNAL_edgemap_PATH/package/python-pytestcov/Config.in"
source "$BR2_EXTERNAL_edgemap_PATH/package/python-pytap2/Config.in"
source "$BR2_EXTERNAL_edgemap_PATH/package/python-pdoc3/Config.in"
source "$BR2_EXTERNAL_edgemap_PATH/package/gpsreader/Config.in"
source "$BR2_EXTERNAL_edgemap_PATH/package/qtencodeui/Config.in"
source "$BR2_EXTERNAL_edgemap_PATH/package/netmon/Config.in"
source "$BR2_EXTERNAL_edgemap_PATH/package/pttcomm/Config.in"
source "$BR2_EXTERNAL_edgemap_PATH/package/samplicator/Config.in"
source "$BR2_EXTERNAL_edgemap_PATH/package/udpproxy/Config.in"
source "$BR2_EXTERNAL_edgemap_PATH/package/dpinger/Config.in"
source "$BR2_EXTERNAL_edgemap_PATH/package/python-print-color/Config.in"
source "$BR2_EXTERNAL_edgemap_PATH/package/python-rns/Config.in"
source "$BR2_EXTERNAL_edgemap_PATH/package/python-lxmf/Config.in"
source "$BR2_EXTERNAL_edgemap_PATH/package/python-nomadnet/Config.in"
source "$BR2_EXTERNAL_edgemap_PATH/package/python-cxfreeze/Config.in"
source "$BR2_EXTERNAL_edgemap_PATH/package/python-peewee/Config.in"
```

## configs/rpi4_edgemap_6.11_defconfig
```kconfig
BR2_aarch64=y
BR2_cortex_a72=y
BR2_ARM_FPU_VFPV4=y
BR2_PACKAGE_HOST_LINUX_HEADERS_CUSTOM_6_11=y
BR2_TOOLCHAIN_BUILDROOT_CXX=y
BR2_TARGET_GENERIC_HOSTNAME="edgemap"
BR2_TARGET_GENERIC_ISSUE="Welcome to edgemap"
BR2_INIT_SYSTEMD=y
BR2_TARGET_GENERIC_ROOT_PASSWD="edgemap"
BR2_SYSTEM_DHCP="end0"
BR2_SYSTEM_DEFAULT_PATH="/bin:/sbin:/usr/bin:/usr/sbin"
BR2_ROOTFS_OVERLAY="${BR2_EXTERNAL}/board/raspberrypi4-64/fs_edgemap"
BR2_ROOTFS_POST_BUILD_SCRIPT="${BR2_EXTERNAL}/board/raspberrypi4-64/post-build.sh"
BR2_ROOTFS_POST_IMAGE_SCRIPT="${BR2_EXTERNAL}/board/raspberrypi4-64/post-image.sh"
BR2_LINUX_KERNEL=y
BR2_LINUX_KERNEL_CUSTOM_TARBALL=y
BR2_LINUX_KERNEL_CUSTOM_TARBALL_LOCATION="$(call github,raspberrypi,linux,fcc85627d0046ca8ca2b812e53aaee7ed6b8dd30)/linux-fcc85627d0046ca8ca2b812e53aaee7ed6b8dd30.tar.gz"
BR2_LINUX_KERNEL_USE_CUSTOM_CONFIG=y
BR2_LINUX_KERNEL_CUSTOM_CONFIG_FILE="${BR2_EXTERNAL}/profiles/kernel/rpi4-kernel-reduced-usb-wifi.config"
BR2_LINUX_KERNEL_DTS_SUPPORT=y
BR2_LINUX_KERNEL_INTREE_DTS_NAME="broadcom/bcm2711-rpi-4-b"
BR2_LINUX_KERNEL_CUSTOM_DTS_PATH="${BR2_EXTERNAL}/profiles/kernel/ptt_keys.dts ${BR2_EXTERNAL}/profiles/kernel/ptt_codec_zero.dts"
BR2_LINUX_KERNEL_NEEDS_HOST_OPENSSL=y
BR2_PACKAGE_ALSA_UTILS=y
BR2_PACKAGE_ALSA_UTILS_APLAY=y
BR2_PACKAGE_FFMPEG=y
BR2_PACKAGE_GST1_PLUGINS_BASE_PLUGIN_AUDIOMIXER=y
BR2_PACKAGE_GST1_PLUGINS_BASE_PLUGIN_AUDIORATE=y
BR2_PACKAGE_GST1_PLUGINS_BASE_PLUGIN_AUDIOTESTSRC=y
BR2_PACKAGE_GST1_PLUGINS_BASE_PLUGIN_ALSA=y
BR2_PACKAGE_GST1_PLUGINS_BASE_PLUGIN_OPUS=y
BR2_PACKAGE_GST1_PLUGINS_GOOD=y
BR2_PACKAGE_GST1_PLUGINS_GOOD_PLUGIN_AUDIOPARSERS=y
BR2_PACKAGE_GST1_PLUGINS_GOOD_PLUGIN_RTP=y
BR2_PACKAGE_GST1_PLUGINS_GOOD_PLUGIN_RTSP=y
BR2_PACKAGE_GST1_PLUGINS_GOOD_PLUGIN_UDP=y
BR2_PACKAGE_MINIMODEM=y
BR2_PACKAGE_OPUS_TOOLS=y
BR2_PACKAGE_E2FSPROGS=y
BR2_PACKAGE_E2FSPROGS_RESIZE2FS=y
BR2_PACKAGE_DEJAVU=y
BR2_PACKAGE_MESA3D=y
BR2_PACKAGE_MESA3D_GALLIUM_DRIVER_V3D=y
BR2_PACKAGE_MESA3D_VULKAN_DRIVER_BROADCOM=y
BR2_PACKAGE_MESA3D_OPENGL_ES=y
BR2_PACKAGE_QT5=y
BR2_PACKAGE_QT5BASE_OPENGL_LIB=y
BR2_PACKAGE_QT5BASE_EGLFS=y
BR2_PACKAGE_QT5BASE_DEFAULT_QPA="eglfs"
BR2_PACKAGE_QT5BASE_FONTCONFIG=y
BR2_PACKAGE_QT5BASE_HARFBUZZ=y
BR2_PACKAGE_QT5BASE_JPEG=y
BR2_PACKAGE_QT5BASE_PNG=y
BR2_PACKAGE_QT5BASE_DBUS=y
BR2_PACKAGE_QT5BASE_ICU=y
BR2_PACKAGE_QT5GRAPHICALEFFECTS=y
BR2_PACKAGE_QT5IMAGEFORMATS=y
BR2_PACKAGE_QT5QUICKCONTROLS=y
BR2_PACKAGE_QT5QUICKCONTROLS2=y
BR2_PACKAGE_QT5VIRTUALKEYBOARD=y
BR2_PACKAGE_QT5XMLPATTERNS=y
BR2_PACKAGE_BRCMFMAC_SDIO_FIRMWARE_RPI=y
BR2_PACKAGE_BRCMFMAC_SDIO_FIRMWARE_RPI_BT=y
BR2_PACKAGE_BRCMFMAC_SDIO_FIRMWARE_RPI_WIFI=y
BR2_PACKAGE_LINUX_FIRMWARE=y
BR2_PACKAGE_LINUX_FIRMWARE_ATHEROS_6002=y
BR2_PACKAGE_LINUX_FIRMWARE_ATHEROS_6003=y
BR2_PACKAGE_LINUX_FIRMWARE_ATHEROS_6004=y
BR2_PACKAGE_LINUX_FIRMWARE_ATHEROS_7010=y
BR2_PACKAGE_LINUX_FIRMWARE_ATHEROS_9170=y
BR2_PACKAGE_LINUX_FIRMWARE_ATHEROS_9271=y
BR2_PACKAGE_LINUX_FIRMWARE_ATHEROS_10K_QCA9377=y
BR2_PACKAGE_LINUX_FIRMWARE_ATHEROS_10K_QCA998X=y
BR2_PACKAGE_LINUX_FIRMWARE_RALINK_RT61=y
BR2_PACKAGE_LINUX_FIRMWARE_RALINK_RT73=y
BR2_PACKAGE_LINUX_FIRMWARE_RALINK_RT2XX=y
BR2_PACKAGE_LINUX_FIRMWARE_RTL_81XX=y
BR2_PACKAGE_LINUX_FIRMWARE_RTL_87XX=y
BR2_PACKAGE_LINUX_FIRMWARE_RTL_88XX=y
BR2_PACKAGE_RPI_FIRMWARE=y
BR2_PACKAGE_RPI_FIRMWARE_VARIANT_PI4=y
BR2_PACKAGE_RPI_FIRMWARE_CONFIG_FILE="${BR2_EXTERNAL}/board/raspberrypi4-64/config_4_64bit.txt"
BR2_PACKAGE_RPI_FIRMWARE_CMDLINE_FILE="${BR2_EXTERNAL}/board/raspberrypi4-64/cmdline.txt"
BR2_PACKAGE_CRYPTSETUP=y
BR2_PACKAGE_EVTEST=y
BR2_PACKAGE_GPSD=y
BR2_PACKAGE_GPSD_DEVICES="/dev/ttyUSB0"
BR2_PACKAGE_GPSD_MAX_CLIENT=y
BR2_PACKAGE_GPSD_MAX_DEV=y
BR2_PACKAGE_GPSD_SQUELCH=y
BR2_PACKAGE_GPSD_ASHTECH=y
BR2_PACKAGE_GPSD_EARTHMATE=y
BR2_PACKAGE_GPSD_EVERMORE=y
BR2_PACKAGE_GPSD_FURY=y
BR2_PACKAGE_GPSD_FV18=y
BR2_PACKAGE_GPSD_GARMIN=y
BR2_PACKAGE_GPSD_GARMIN_SIMPLE_TXT=y
BR2_PACKAGE_GPSD_GEOSTAR=y
BR2_PACKAGE_GPSD_GPSCLOCK=y
BR2_PACKAGE_GPSD_GREIS=y
BR2_PACKAGE_GPSD_ISYNC=y
BR2_PACKAGE_GPSD_ITRAX=y
BR2_PACKAGE_GPSD_NMEA2000=y
BR2_PACKAGE_GPSD_OCEANSERVER=y
BR2_PACKAGE_GPSD_ONCORE=y
BR2_PACKAGE_GPSD_RTCM104V2=y
BR2_PACKAGE_GPSD_RTCM104V3=y
BR2_PACKAGE_GPSD_SIRF=y
BR2_PACKAGE_GPSD_SKYTRAQ=y
BR2_PACKAGE_GPSD_SUPERSTAR2=y
BR2_PACKAGE_GPSD_TRIMBLE_TSIP=y
BR2_PACKAGE_GPSD_TRIPMATE=y
BR2_PACKAGE_GPSD_TRUE_NORTH=y
BR2_PACKAGE_GPSD_UBX=y
BR2_PACKAGE_HDPARM=y
BR2_PACKAGE_LSHW=y
BR2_PACKAGE_PARTED=y
BR2_PACKAGE_PHP=y
BR2_PACKAGE_PHP_SAPI_APACHE=y
BR2_PACKAGE_PHP_SAPI_CGI=y
BR2_PACKAGE_PHP_EXT_SQLITE=y
BR2_PACKAGE_PHP_EXT_PDO=y
BR2_PACKAGE_PHP_EXT_PDO_SQLITE=y
BR2_PACKAGE_PHP_EXT_GD=y
BR2_PACKAGE_PHP_EXT_XML=y
BR2_PACKAGE_PYTHON3_PY_PYC=y
BR2_PACKAGE_PYTHON3_BZIP2=y
BR2_PACKAGE_PYTHON3_SQLITE=y
BR2_PACKAGE_PYTHON_AIOHTTP=y
BR2_PACKAGE_PYTHON_BLEAK=y
BR2_PACKAGE_PYTHON_MARKDOWN=y
BR2_PACKAGE_PYTHON_PEXPECT=y
BR2_PACKAGE_PYTHON_PIP=y
BR2_PACKAGE_PYTHON_PROTOBUF=y
BR2_PACKAGE_PYTHON_PYPARSING=y
BR2_PACKAGE_PYTHON_PYQRCODE=y
BR2_PACKAGE_PYTHON_PYTEST=y
BR2_PACKAGE_PYTHON_PYYAML=y
BR2_PACKAGE_PYTHON_QRCODE=y
BR2_PACKAGE_PYTHON_REQUESTS=y
BR2_PACKAGE_PYTHON_SERIAL=y
BR2_PACKAGE_PYTHON_URWID_READLINE=y
BR2_PACKAGE_PYTHON_WEBENCODINGS=y
BR2_PACKAGE_PYTHON_WEBSOCKETS=y
BR2_PACKAGE_LIBCODEC2=y
BR2_PACKAGE_LIBCODEC2_EXAMPLES=y
BR2_PACKAGE_LIBVORBIS=y
BR2_PACKAGE_SPEEX=y
BR2_PACKAGE_MINIZIP=y
BR2_PACKAGE_SNAPPY=y
BR2_PACKAGE_GNUTLS=y
BR2_PACKAGE_GNUTLS_OPENSSL=y
BR2_PACKAGE_GNUTLS_TOOLS=y
BR2_PACKAGE_LIBNSS=y
BR2_PACKAGE_LIBOPENSSL_BIN=y
BR2_PACKAGE_PKCS11_HELPER=y
BR2_PACKAGE_SQLITE_ENABLE_JSON1=y
BR2_PACKAGE_LCMS2=y
BR2_PACKAGE_LIBQRENCODE=y
BR2_PACKAGE_LIBQRENCODE_TOOLS=y
BR2_PACKAGE_WEBP=y
BR2_PACKAGE_WEBP_DEMUX=y
BR2_PACKAGE_WEBP_MUX=y
BR2_PACKAGE_CCID=y
BR2_PACKAGE_LIBXKBCOMMON=y
BR2_PACKAGE_OPENSC=y
BR2_PACKAGE_LIBVPX=y
BR2_PACKAGE_C_ARES=y
BR2_PACKAGE_NGHTTP2=y
BR2_PACKAGE_LIBEVENT=y
BR2_PACKAGE_LIBUV=y
BR2_PACKAGE_LIBFRIBIDI=y
BR2_PACKAGE_RE2=y
BR2_PACKAGE_READLINE=y
BR2_PACKAGE_APACHE=y
BR2_PACKAGE_DNSMASQ=y
BR2_PACKAGE_ETHTOOL=y
BR2_PACKAGE_GLORYTUN=y
BR2_PACKAGE_HOSTAPD=y
BR2_PACKAGE_IODINE=y
BR2_PACKAGE_IPERF3=y
BR2_PACKAGE_IPROUTE2=y
BR2_PACKAGE_IPTABLES=y
BR2_PACKAGE_IPTABLES_NFTABLES=y
BR2_PACKAGE_IW=y
BR2_PACKAGE_IWD=y
BR2_PACKAGE_JANUS_GATEWAY=y
BR2_PACKAGE_JANUS_GATEWAY_DEMOS=y
BR2_PACKAGE_JANUS_GATEWAY_AUDIO_BRIDGE=y
BR2_PACKAGE_JANUS_GATEWAY_ECHO_TEST=y
BR2_PACKAGE_JANUS_GATEWAY_RECORDPLAY=y
BR2_PACKAGE_JANUS_GATEWAY_STREAMING=y
BR2_PACKAGE_JANUS_GATEWAY_TEXT_ROOM=y
BR2_PACKAGE_JANUS_GATEWAY_VIDEO_CALL=y
BR2_PACKAGE_JANUS_GATEWAY_VIDEO_ROOM=y
BR2_PACKAGE_JANUS_GATEWAY_VOICE_MAIL=y
BR2_PACKAGE_JANUS_GATEWAY_REST=y
BR2_PACKAGE_JANUS_GATEWAY_WEBSOCKETS=y
BR2_PACKAGE_NETCAT=y
BR2_PACKAGE_NFTABLES=y
BR2_PACKAGE_OPENSSH=y
BR2_PACKAGE_RSYNC=y
BR2_PACKAGE_TCPDUMP=y
BR2_PACKAGE_TRACEROUTE=y
BR2_PACKAGE_WGET=y
BR2_PACKAGE_WIREGUARD_TOOLS=y
BR2_PACKAGE_GNUPG2=y
BR2_PACKAGE_HTOP=y
BR2_PACKAGE_KEYUTILS=y
BR2_PACKAGE_SCRUB=y
# BR2_PACKAGE_SYSTEMD_HWDB is not set
BR2_PACKAGE_UTIL_LINUX_BINARIES=y
BR2_PACKAGE_UTIL_LINUX_MOUNTPOINT=y
BR2_PACKAGE_NANO=y
BR2_TARGET_ROOTFS_EXT2=y
BR2_TARGET_ROOTFS_EXT2_4=y
BR2_TARGET_ROOTFS_EXT2_SIZE="1000M"
BR2_PACKAGE_HOST_DOSFSTOOLS=y
BR2_PACKAGE_HOST_GENIMAGE=y
BR2_PACKAGE_HOST_MTOOLS=y
BR2_PACKAGE_HOST_NODEJS=y
BR2_PACKAGE_HOST_PYTHON3_BZIP2=y
BR2_PACKAGE_HOST_PYTHON3_SSL=y
BR2_PACKAGE_HOST_QEMU=y
BR2_PACKAGE_HOST_QEMU_SYSTEM_MODE=y
BR2_PACKAGE_HOST_QEMU_LINUX_USER_MODE=y
BR2_PACKAGE_PYTHON_DATEUTILS=y
BR2_PACKAGE_PYTHON_TAKY=y
BR2_PACKAGE_GWSOCKET=y
BR2_PACKAGE_HIGHRATE=y
BR2_PACKAGE_CURLCOT=y
BR2_PACKAGE_COTSIM=y
BR2_PACKAGE_TACMSGROUTER=y
BR2_PACKAGE_AUDIORECEIVER=y
BR2_PACKAGE_AUDIOSTREAMER=y
BR2_PACKAGE_UDP2RAW=y
BR2_PACKAGE_RTPTUN=y
BR2_PACKAGE_UDPTUNNEL=y
BR2_PACKAGE_LIBBLINKSTICK=y
BR2_PACKAGE_LIBFIDO2=y
BR2_PACKAGE_LIBCBOR=y
BR2_PACKAGE_PYTHON_MESHTASTIC=y
BR2_PACKAGE_PYTHON_PUBSUB=y
BR2_PACKAGE_PYTHON_DOTMAP=y
BR2_PACKAGE_PYTHON_TABULATE=y
BR2_PACKAGE_PYTHON_TIMEAGO=y
BR2_PACKAGE_PYTHON_TWINE=y
BR2_PACKAGE_PYTHON_AUTOPEP8=y
BR2_PACKAGE_PYTHON_PYLINT=y
BR2_PACKAGE_PYTHON_PYTESTCOV=y
BR2_PACKAGE_PYTHON_PYTAP2=y
BR2_PACKAGE_GPSREADER=y
BR2_PACKAGE_QTENCODEUI=y
BR2_PACKAGE_NETMON=y
BR2_PACKAGE_PTTCOMM=y
BR2_PACKAGE_SAMPLICATOR=y
BR2_PACKAGE_UDPPROXY=y
BR2_PACKAGE_DPINGER=y
BR2_PACKAGE_PYTHON_PRINT_COLOR=y
BR2_PACKAGE_PYTHON_RNS=y
BR2_PACKAGE_PYTHON_LXMF=y
BR2_PACKAGE_PYTHON_NOMADNET=y
BR2_PACKAGE_PYTHON_PEEWEE=y
BR2_PACKAGE_PYTHON_PROPCACHE=y
```

## package/cryptpad/Config.in
```kconfig
config BR2_PACKAGE_CRYPTPAD
    bool "cryptpad"
    depends on BR2_PACKAGE_NODEJS
    help
      CryptPad is a collaboration suite, end-to-end encrypted.

      https://github.com/cryptpad/cryptpad
```

## package/ircpipe/Config.in
```kconfig
config BR2_PACKAGE_IRCPIPE
        bool "ircpipe"
        help 
              IRC server pipess
```

## package/kamailio/Config.in
```kconfig
config BR2_PACKAGE_KAMAILIO
        bool "kamailio"
        help 
              Kamailio - The Open Source SIP Server
```

## package/python-propcache/Config.in
```kconfig
config BR2_PACKAGE_PYTHON_PROPCACHE
	bool "python-propcache"
	help
	
	  Accelerated property cache
```

## package/thelounge/Config.in
```kconfig
config BR2_PACKAGE_THELOUNGE
    bool "thelounge"
    depends on BR2_PACKAGE_NODEJS
    help
      The self-hosted web IRC client

      https://thelounge.chat/
```
